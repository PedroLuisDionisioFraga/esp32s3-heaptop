## Kconfig
```kconfig
menu "Heaptop"

    # uxTaskGetSystemState() exists only with the FreeRTOS trace facility
    # (off by default in IDF); it costs a few bytes per task.
    config HEAPTOP_SELECT_TRACE_FACILITY
        bool
        default y
        select FREERTOS_USE_TRACE_FACILITY

    config HEAPTOP_SAMPLE_PERIOD_MS
        int "Sampling period (ms)"
        range 100 60000
        default 1000
        help
            How often the sampler task takes a heap and task snapshot.
            heap_caps_get_info() walks every heap block with a spinlock held,
            so very short periods add interrupt latency.

            Everything else is automatic: heaptop reads whichever IDF data
            sources are enabled (run-time stats, heap task tracking) and puts
            its buffers in PSRAM when the chip has it.

    config HEAPTOP_STREAM_AT_BOOT
        bool "Start the JSON Lines stream at boot"
        default n
        help
            Emits heaptop samples on stdout without a console, for headless
            devices read by a host script.

    menu "Alert thresholds"

        config HEAPTOP_ALERT_DRAM_FREE_MIN
            int "Internal RAM free floor (bytes, 0 = off)"
            range 0 16777216
            default 20480

        config HEAPTOP_ALERT_DRAM_LARGEST_MIN
            int "Internal RAM largest free block floor (bytes, 0 = off)"
            range 0 16777216
            default 8192

        config HEAPTOP_ALERT_FRAG_PCT_MAX
            int "Internal RAM fragmentation ceiling (%, 0 = off)"
            range 0 100
            default 80

        config HEAPTOP_ALERT_PSRAM_FREE_MIN
            int "PSRAM free floor (bytes, 0 = off)"
            range 0 134217728
            default 65536

        config HEAPTOP_ALERT_STACK_HWM_MIN
            int "Task stack high-water mark floor (bytes, 0 = off)"
            range 0 65536
            default 256
            help
                IDF's own ipc tasks normally keep only 500-600 bytes free, so a
                floor near 512 would keep this alert on all the time.

        config HEAPTOP_ALERT_TASK_GROWTH
            int "Task heap growth over the history window (bytes, 0 = off)"
            range 0 16777216
            default 4096
            help
                A task is a leak suspect when its heap grew by at least this much
                across the history window in several separate steps, grew in
                every third of the window, never dropped below where it started,
                and still holds nearly all of it.

    endmenu

endmenu
```
